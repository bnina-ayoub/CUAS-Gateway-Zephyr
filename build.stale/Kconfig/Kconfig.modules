## build.stale/Kconfig/Kconfig.modules
```kconfig
menu "cmsis (/home/bninaos/NXP_Projects/CAN_Node_Project/modules/hal/cmsis)"
osource "$(ZEPHYR_CMSIS_KCONFIG)"
config ZEPHYR_CMSIS_MODULE
	bool
	default y
endmenu
menu "cmsis_6 (/home/bninaos/NXP_Projects/CAN_Node_Project/modules/hal/cmsis_6)"
osource "$(ZEPHYR_CMSIS_6_KCONFIG)"
config ZEPHYR_CMSIS_6_MODULE
	bool
	default y
endmenu
menu "hal_nxp (/home/bninaos/NXP_Projects/CAN_Node_Project/modules/hal/nxp)"
osource "$(ZEPHYR_HAL_NXP_KCONFIG)"
config ZEPHYR_HAL_NXP_MODULE
	bool
	default y

config ZEPHYR_HAL_NXP_MODULE_BLOBS
	bool
endmenu
```

## build.stale/Kconfig/Kconfig.sysbuild.modules
```kconfig
config ZEPHYR_CMSIS_MODULE
   bool
   default y
config ZEPHYR_CMSIS_6_MODULE
   bool
   default y
config ZEPHYR_HAL_NXP_MODULE
   bool
   default y
```

## build.stale/Kconfig/arch/Kconfig
```kconfig
# Load Zephyr Arch Kconfig descriptions.
osource "/home/bninaos/NXP_Projects/CAN_Node_Project/zephyr/arch/rx/Kconfig"
osource "/home/bninaos/NXP_Projects/CAN_Node_Project/zephyr/arch/x86/Kconfig"
osource "/home/bninaos/NXP_Projects/CAN_Node_Project/zephyr/arch/xtensa/Kconfig"
osource "/home/bninaos/NXP_Projects/CAN_Node_Project/zephyr/arch/sparc/Kconfig"
osource "/home/bninaos/NXP_Projects/CAN_Node_Project/zephyr/arch/riscv/Kconfig"
osource "/home/bninaos/NXP_Projects/CAN_Node_Project/zephyr/arch/posix/Kconfig"
osource "/home/bninaos/NXP_Projects/CAN_Node_Project/zephyr/arch/openrisc/Kconfig"
osource "/home/bninaos/NXP_Projects/CAN_Node_Project/zephyr/arch/mips/Kconfig"
osource "/home/bninaos/NXP_Projects/CAN_Node_Project/zephyr/arch/arm64/Kconfig"
osource "/home/bninaos/NXP_Projects/CAN_Node_Project/zephyr/arch/arm/Kconfig"
osource "/home/bninaos/NXP_Projects/CAN_Node_Project/zephyr/arch/arc/Kconfig"
```

## build.stale/Kconfig/boards/Kconfig.defconfig
```kconfig
# Load Zephyr board defconfig descriptions.
osource "/home/bninaos/NXP_Projects/CAN_Node_Project/zephyr/boards/nxp/frdm_mcxa156/Kconfig.defconfig"
```

## build.stale/Kconfig/boards/Kconfig.sysbuild
```kconfig
# Load Sysbuild board Kconfig descriptions.
osource "/home/bninaos/NXP_Projects/CAN_Node_Project/zephyr/boards/nxp/frdm_mcxa156/Kconfig.sysbuild"
```

## build.stale/Kconfig/soc/Kconfig
```kconfig
# Load Zephyr SoC Kconfig descriptions.
osource "/home/bninaos/NXP_Projects/CAN_Node_Project/zephyr/soc/xlnx/zynqmp/Kconfig"
osource "/home/bninaos/NXP_Projects/CAN_Node_Project/zephyr/soc/xlnx/zynq7000/Kconfig"
osource "/home/bninaos/NXP_Projects/CAN_Node_Project/zephyr/soc/xlnx/versalnet/Kconfig"
osource "/home/bninaos/NXP_Projects/CAN_Node_Project/zephyr/soc/xlnx/versal2/Kconfig"
osource "/home/bninaos/NXP_Projects/CAN_Node_Project/zephyr/soc/xlnx/versal/Kconfig"
osource "/home/bninaos/NXP_Projects/CAN_Node_Project/zephyr/soc/xen/Kconfig"
osource "/home/bninaos/NXP_Projects/CAN_Node_Project/zephyr/soc/wch/ch32v/Kconfig"
osource "/home/bninaos/NXP_Projects/CAN_Node_Project/zephyr/soc/ti/simplelink/Kconfig"
osource "/home/bninaos/NXP_Projects/CAN_Node_Project/zephyr/soc/ti/mspm0/Kconfig"
osource "/home/bninaos/NXP_Projects/CAN_Node_Project/zephyr/soc/ti/lm3s6965/Kconfig"
osource "/home/bninaos/NXP_Projects/CAN_Node_Project/zephyr/soc/ti/k3/Kconfig"
osource "/home/bninaos/NXP_Projects/CAN_Node_Project/zephyr/soc/telink/tlsr/Kconfig"
osource "/home/bninaos/NXP_Projects/CAN_Node_Project/zephyr/soc/syna/sr100/Kconfig"
osource "/home/bninaos/NXP_Projects/CAN_Node_Project/zephyr/soc/starfive/jh71xx/Kconfig"
osource "/home/bninaos/NXP_Projects/CAN_Node_Project/zephyr/soc/st/stm32/Kconfig"
osource "/home/bninaos/NXP_Projects/CAN_Node_Project/zephyr/soc/snps/qemu_arc/Kconfig"
osource "/home/bninaos/NXP_Projects/CAN_Node_Project/zephyr/soc/snps/nsim/arc_v/Kconfig"
osource "/home/bninaos/NXP_Projects/CAN_Node_Project/zephyr/soc/snps/nsim/arc_classic/Kconfig"
osource "/home/bninaos/NXP_Projects/CAN_Node_Project/zephyr/soc/snps/hsdk4xd/Kconfig"
osource "/home/bninaos/NXP_Projects/CAN_Node_Project/zephyr/soc/snps/hsdk/Kconfig"
osource "/home/bninaos/NXP_Projects/CAN_Node_Project/zephyr/soc/snps/emsk/Kconfig"
osource "/home/bninaos/NXP_Projects/CAN_Node_Project/zephyr/soc/snps/emsdp/Kconfig"
osource "/home/bninaos/NXP_Projects/CAN_Node_Project/zephyr/soc/snps/arc_iot/Kconfig"
osource "/home/bninaos/NXP_Projects/CAN_Node_Project/zephyr/soc/silabs/Kconfig"
osource "/home/bninaos/NXP_Projects/CAN_Node_Project/zephyr/soc/sifli/sf32/Kconfig"
osource "/home/bninaos/NXP_Projects/CAN_Node_Project/zephyr/soc/sifive/sifive_freedom/Kconfig"
osource "/home/bninaos/NXP_Projects/CAN_Node_Project/zephyr/soc/sensry/Kconfig"
osource "/home/bninaos/NXP_Projects/CAN_Node_Project/zephyr/soc/rockchip/Kconfig"
osource "/home/bninaos/NXP_Projects/CAN_Node_Project/zephyr/soc/renode/riscv_virtual/Kconfig"
osource "/home/bninaos/NXP_Projects/CAN_Node_Project/zephyr/soc/renode/cortex_r8_virtual/Kconfig"
osource "/home/bninaos/NXP_Projects/CAN_Node_Project/zephyr/soc/renesas/smartbond/Kconfig"
osource "/home/bninaos/NXP_Projects/CAN_Node_Project/zephyr/soc/renesas/rz/Kconfig"
osource "/home/bninaos/NXP_Projects/CAN_Node_Project/zephyr/soc/renesas/rx/Kconfig"
osource "/home/bninaos/NXP_Projects/CAN_Node_Project/zephyr/soc/renesas/rcar/Kconfig"
osource "/home/bninaos/NXP_Projects/CAN_Node_Project/zephyr/soc/renesas/ra/Kconfig"
osource "/home/bninaos/NXP_Projects/CAN_Node_Project/zephyr/soc/realtek/fingerprint/Kconfig"
osource "/home/bninaos/NXP_Projects/CAN_Node_Project/zephyr/soc/realtek/ec/Kconfig"
osource "/home/bninaos/NXP_Projects/CAN_Node_Project/zephyr/soc/realtek/bee/Kconfig"
osource "/home/bninaos/NXP_Projects/CAN_Node_Project/zephyr/soc/realtek/ameba/Kconfig"
osource "/home/bninaos/NXP_Projects/CAN_Node_Project/zephyr/soc/raspberrypi/rpi_pico/Kconfig"
osource "/home/bninaos/NXP_Projects/CAN_Node_Project/zephyr/soc/quicklogic/eos_s3/Kconfig"
osource "/home/bninaos/NXP_Projects/CAN_Node_Project/zephyr/soc/qemu/virt_riscv/Kconfig"
osource "/home/bninaos/NXP_Projects/CAN_Node_Project/zephyr/soc/qemu/or1k/Kconfig"
osource "/home/bninaos/NXP_Projects/CAN_Node_Project/zephyr/soc/qemu/malta/Kconfig"
osource "/home/bninaos/NXP_Projects/CAN_Node_Project/zephyr/soc/openisa/rv32m1/Kconfig"
osource "/home/bninaos/NXP_Projects/CAN_Node_Project/zephyr/soc/openhwgroup/cva6/Kconfig"
osource "/home/bninaos/NXP_Projects/CAN_Node_Project/zephyr/soc/oct/osd32mp15x/Kconfig"
osource "/home/bninaos/NXP_Projects/CAN_Node_Project/zephyr/soc/nxp/s32/Kconfig"
osource "/home/bninaos/NXP_Projects/CAN_Node_Project/zephyr/soc/nxp/rw/Kconfig"
osource "/home/bninaos/NXP_Projects/CAN_Node_Project/zephyr/soc/nxp/mcx/Kconfig"
osource "/home/bninaos/NXP_Projects/CAN_Node_Project/zephyr/soc/nxp/lpc/Kconfig"
osource "/home/bninaos/NXP_Projects/CAN_Node_Project/zephyr/soc/nxp/layerscape/Kconfig"
osource "/home/bninaos/NXP_Projects/CAN_Node_Project/zephyr/soc/nxp/kinetis/Kconfig"
osource "/home/bninaos/NXP_Projects/CAN_Node_Project/zephyr/soc/nxp/imxrt/Kconfig"
osource "/home/bninaos/NXP_Projects/CAN_Node_Project/zephyr/soc/nxp/imx/Kconfig"
osource "/home/bninaos/NXP_Projects/CAN_Node_Project/zephyr/soc/nuvoton/numicro/Kconfig"
osource "/home/bninaos/NXP_Projects/CAN_Node_Project/zephyr/soc/nuvoton/numaker/Kconfig"
osource "/home/bninaos/NXP_Projects/CAN_Node_Project/zephyr/soc/nuvoton/npcx/Kconfig"
osource "/home/bninaos/NXP_Projects/CAN_Node_Project/zephyr/soc/nuvoton/npcm/Kconfig"
osource "/home/bninaos/NXP_Projects/CAN_Node_Project/zephyr/soc/nordic/Kconfig"
osource "/home/bninaos/NXP_Projects/CAN_Node_Project/zephyr/soc/neorv32/Kconfig"
osource "/home/bninaos/NXP_Projects/CAN_Node_Project/zephyr/soc/native/inf_clock/Kconfig"
osource "/home/bninaos/NXP_Projects/CAN_Node_Project/zephyr/soc/microchip/sam/sama7/Kconfig"
osource "/home/bninaos/NXP_Projects/CAN_Node_Project/zephyr/soc/microchip/sam/sam_d5x_e5x/Kconfig"
osource "/home/bninaos/NXP_Projects/CAN_Node_Project/zephyr/soc/microchip/pic64/Kconfig"
osource "/home/bninaos/NXP_Projects/CAN_Node_Project/zephyr/soc/microchip/pic32c/pic32cz_ca/Kconfig"
osource "/home/bninaos/NXP_Projects/CAN_Node_Project/zephyr/soc/microchip/pic32c/pic32cx_sg/Kconfig"
osource "/home/bninaos/NXP_Projects/CAN_Node_Project/zephyr/soc/microchip/pic32c/pic32cm_sg_gc/Kconfig"
osource "/home/bninaos/NXP_Projects/CAN_Node_Project/zephyr/soc/microchip/pic32c/pic32cm_pl/Kconfig"
osource "/home/bninaos/NXP_Projects/CAN_Node_Project/zephyr/soc/microchip/pic32c/pic32cm_jh/Kconfig"
osource "/home/bninaos/NXP_Projects/CAN_Node_Project/zephyr/soc/microchip/pic32c/pic32ck_sg_gc/Kconfig"
osource "/home/bninaos/NXP_Projects/CAN_Node_Project/zephyr/soc/microchip/miv/Kconfig"
osource "/home/bninaos/NXP_Projects/CAN_Node_Project/zephyr/soc/microchip/mec/Kconfig"
osource "/home/bninaos/NXP_Projects/CAN_Node_Project/zephyr/soc/mediatek/mt8xxx/Kconfig"
osource "/home/bninaos/NXP_Projects/CAN_Node_Project/zephyr/soc/lowrisc/opentitan/Kconfig"
osource "/home/bninaos/NXP_Projects/CAN_Node_Project/zephyr/soc/litex/Kconfig"
osource "/home/bninaos/NXP_Projects/CAN_Node_Project/zephyr/soc/ite/ec/Kconfig"
osource "/home/bninaos/NXP_Projects/CAN_Node_Project/zephyr/soc/intel/wildcat_lake/Kconfig"
osource "/home/bninaos/NXP_Projects/CAN_Node_Project/zephyr/soc/intel/raptor_lake/Kconfig"
osource "/home/bninaos/NXP_Projects/CAN_Node_Project/zephyr/soc/intel/panther_lake/Kconfig"
osource "/home/bninaos/NXP_Projects/CAN_Node_Project/zephyr/soc/intel/lakemont/Kconfig"
osource "/home/bninaos/NXP_Projects/CAN_Node_Project/zephyr/soc/intel/intel_socfpga_std/Kconfig"
osource "/home/bninaos/NXP_Projects/CAN_Node_Project/zephyr/soc/intel/intel_socfpga/Kconfig"
osource "/home/bninaos/NXP_Projects/CAN_Node_Project/zephyr/soc/intel/intel_niosv/Kconfig"
osource "/home/bninaos/NXP_Projects/CAN_Node_Project/zephyr/soc/intel/intel_ish/Kconfig"
osource "/home/bninaos/NXP_Projects/CAN_Node_Project/zephyr/soc/intel/intel_adsp/Kconfig"
osource "/home/bninaos/NXP_Projects/CAN_Node_Project/zephyr/soc/intel/elkhart_lake/Kconfig"
osource "/home/bninaos/NXP_Projects/CAN_Node_Project/zephyr/soc/intel/atom/Kconfig"
osource "/home/bninaos/NXP_Projects/CAN_Node_Project/zephyr/soc/intel/apollo_lake/Kconfig"
osource "/home/bninaos/NXP_Projects/CAN_Node_Project/zephyr/soc/intel/alder_lake/Kconfig"
osource "/home/bninaos/NXP_Projects/CAN_Node_Project/zephyr/soc/infineon/psoc4/Kconfig"
osource "/home/bninaos/NXP_Projects/CAN_Node_Project/zephyr/soc/infineon/edge/Kconfig"
osource "/home/bninaos/NXP_Projects/CAN_Node_Project/zephyr/soc/infineon/cat3/Kconfig"
osource "/home/bninaos/NXP_Projects/CAN_Node_Project/zephyr/soc/infineon/cat1c/Kconfig"
osource "/home/bninaos/NXP_Projects/CAN_Node_Project/zephyr/soc/infineon/cat1b/Kconfig"
osource "/home/bninaos/NXP_Projects/CAN_Node_Project/zephyr/soc/infineon/cat1a/Kconfig"
osource "/home/bninaos/NXP_Projects/CAN_Node_Project/zephyr/soc/gd/gd32/Kconfig"
osource "/home/bninaos/NXP_Projects/CAN_Node_Project/zephyr/soc/gaisler/leon3/Kconfig"
osource "/home/bninaos/NXP_Projects/CAN_Node_Project/zephyr/soc/gaisler/gr716a/Kconfig"
osource "/home/bninaos/NXP_Projects/CAN_Node_Project/zephyr/soc/focaltech/Kconfig"
osource "/home/bninaos/NXP_Projects/CAN_Node_Project/zephyr/soc/espressif/Kconfig"
osource "/home/bninaos/NXP_Projects/CAN_Node_Project/zephyr/soc/ene/kb1200/Kconfig"
osource "/home/bninaos/NXP_Projects/CAN_Node_Project/zephyr/soc/ene/kb106x/Kconfig"
osource "/home/bninaos/NXP_Projects/CAN_Node_Project/zephyr/soc/elan/em32f967/Kconfig"
osource "/home/bninaos/NXP_Projects/CAN_Node_Project/zephyr/soc/egis/Kconfig"
osource "/home/bninaos/NXP_Projects/CAN_Node_Project/zephyr/soc/efinix/sapphire/Kconfig"
osource "/home/bninaos/NXP_Projects/CAN_Node_Project/zephyr/soc/cdns/xtensa_sample_controller/Kconfig"
osource "/home/bninaos/NXP_Projects/CAN_Node_Project/zephyr/soc/cdns/swerv/Kconfig"
osource "/home/bninaos/NXP_Projects/CAN_Node_Project/zephyr/soc/cdns/sample_controller32/Kconfig"
osource "/home/bninaos/NXP_Projects/CAN_Node_Project/zephyr/soc/cdns/dc233c/Kconfig"
osource "/home/bninaos/NXP_Projects/CAN_Node_Project/zephyr/soc/brcm/bcmvk/Kconfig"
osource "/home/bninaos/NXP_Projects/CAN_Node_Project/zephyr/soc/brcm/bcm2712/Kconfig"
osource "/home/bninaos/NXP_Projects/CAN_Node_Project/zephyr/soc/brcm/bcm2711/Kconfig"
osource "/home/bninaos/NXP_Projects/CAN_Node_Project/zephyr/soc/blackberry/qnxhv_vm/Kconfig"
osource "/home/bninaos/NXP_Projects/CAN_Node_Project/zephyr/soc/bflb/Kconfig"
osource "/home/bninaos/NXP_Projects/CAN_Node_Project/zephyr/soc/atmel/sam0/Kconfig"
osource "/home/bninaos/NXP_Projects/CAN_Node_Project/zephyr/soc/atmel/sam/Kconfig"
osource "/home/bninaos/NXP_Projects/CAN_Node_Project/zephyr/soc/aspeed/Kconfig"
osource "/home/bninaos/NXP_Projects/CAN_Node_Project/zephyr/soc/arm/Kconfig"
osource "/home/bninaos/NXP_Projects/CAN_Node_Project/zephyr/soc/arm/beetle/Kconfig"
osource "/home/bninaos/NXP_Projects/CAN_Node_Project/zephyr/soc/antmicro/myra/Kconfig"
osource "/home/bninaos/NXP_Projects/CAN_Node_Project/zephyr/soc/andestech/Kconfig"
osource "/home/bninaos/NXP_Projects/CAN_Node_Project/zephyr/soc/amd/acp_7_x/Kconfig"
osource "/home/bninaos/NXP_Projects/CAN_Node_Project/zephyr/soc/amd/acp_7_0/Kconfig"
osource "/home/bninaos/NXP_Projects/CAN_Node_Project/zephyr/soc/amd/acp_6_0/Kconfig"
osource "/home/bninaos/NXP_Projects/CAN_Node_Project/zephyr/soc/ambiq/Kconfig"
osource "/home/bninaos/NXP_Projects/CAN_Node_Project/zephyr/soc/allwinner/sun8i_h3/Kconfig"
osource "/home/bninaos/NXP_Projects/CAN_Node_Project/zephyr/soc/allwinner/sun50i_h618/Kconfig"
osource "/home/bninaos/NXP_Projects/CAN_Node_Project/zephyr/soc/alif/ensemble/Kconfig"
osource "/home/bninaos/NXP_Projects/CAN_Node_Project/zephyr/soc/alif/balletto/Kconfig"
osource "/home/bninaos/NXP_Projects/CAN_Node_Project/zephyr/soc/aesc/Kconfig"
osource "/home/bninaos/NXP_Projects/CAN_Node_Project/zephyr/soc/adi/max32/Kconfig"
```
